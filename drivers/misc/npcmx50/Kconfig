## drivers/misc/npcmx50/Kconfig
```kconfig
#
# NPCMX50 MISC drivers
#
menu "Nuvoton Miscellaneous optional drivers"

config NPCMX50_GPIO
	tristate "support npcmx50 gpio"
	depends on ARCH_NPCMX50
	default y
	help
	  Say Y here if you want ioctl npcmx50 GPIO access.

	  To compile this driver as a module, choose M here: the
	  module will be called aess_gpiodrv.

config NPCMX50_KCS
	tristate "support npcmx50 KCS on LPC"
	depends on ARCH_NPCMX50
	default y
	help
	  Say Y here if you want ioctl npcmx50 KCS on LPC.

	  To compile this driver as a module, choose M here: the
	  module will be called aess_kcsdrv.

config NPCMX50_BIOS_POST_CODE
	tristate "support npcmx50 BIOS POST CODE monitoring on LPC"
	depends on ARCH_NPCMX50
	default y
	help
	  Say Y here if you want ioctl npcmx50 BIOS POST CODE monitoring on LPC.

	  To compile this driver as a module, choose M here: the
	  module will be called aess_biospostdrv.

config NPCMX50_PSPI
	tristate "support npcmx50 Peripheral SPI bus connection"
	depends on ARCH_NPCMX50
	select NPCMX50_GPIO
	default y
	help
	  Say Y here if you want ioctl npcmx50 Peripheral SPI bus connection.

	  To compile this driver as a module, choose M here: the
	  module will be called aess_sspidrv.

config NPCMX50_VDM
	tristate "support npcmx50 VDM on PCIe"
	depends on ARCH_NPCMX50
	default y
	help
	  Say Y here if you want ioctl npcmx50 VDM on PCIe.

	  To compile this driver as a module, choose M here: the
	  module will be called npcmx50_vdm.

endmenu
```

## drivers/net/ethernet/nuvoton/Kconfig
```kconfig
#
# Nuvoton network device configuration
#

config NET_VENDOR_NUVOTON
	bool "Nuvoton devices"
	default y
	depends on ARM && (ARCH_W90X900 || ARCH_NPCMX50)
	---help---
	  If you have a network (Ethernet) card belonging to this class, say Y.

	  Note that the answer to this question doesn't directly affect the
	  kernel: saying N will just cause the configurator to skip all
	  the questions about Nuvoton cards. If you say Y, you will be asked
	  for your specific card in the following questions.

if NET_VENDOR_NUVOTON

config W90P910_ETH
	tristate "Nuvoton w90p910 Ethernet support"
	depends on ARM && ARCH_W90X900
	select PHYLIB
	select MII
	---help---
	  Say Y here if you want to use built-in Ethernet ports
	  on w90p910 processor.

config NPCM750_EMC_ETH
	bool "Nuvoton NPCM750 Ethernet EMC"
	depends on ARM && ARCH_NPCMX50 && MACH_NPCM750
	select PHYLIB
	select NET_CORE
	select MII
	---help---
	  Say Y here if you want to use built-in Ethernet MAC
	  on NPCM750 MCU.

config NPCM750_EMC_ETH_DEBUG
	bool "Nuvoton NPCM750 Ethernet EMC debug"
	depends on NPCM750_EMC_ETH
	---help---
	  Say Y here if you want debug info via /proc/driver/npcm750_emc.x

config NPCM750_EMC_ETH_DEBUG_EXT
	bool "Nuvoton NPCM750 Ethernet EMC extra debug"
	depends on NPCM750_EMC_ETH_DEBUG
	---help---
	  Say Y here if you want extra debug info via /proc/driver/npcm750_emc.x

config NPCMX50_GMAC_ETH
	bool "Nuvoton NPCMX50 GMAC ethernet driver (STMicro based)"
	depends on ARM && ARCH_NPCMX50 && MACH_NPCM750
	select NET_VENDOR_STMICRO
	select STMMAC_ETH
	select STMMAC_PLATFORM
	help 
	 no	

endif # NET_VENDOR_NUVOTON
```
